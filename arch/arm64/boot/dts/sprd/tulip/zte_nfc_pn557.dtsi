&i2c2 {
	status = "okay";
        #address-cells = <1>;
        #size-cells = <0>;
        nfc_pn5xx: pn544@28 {
                compatible = "nxp,pn544";
		reg = <0x28>;
                interrupt-parent = <&ap_gpio>;
                interrupts = <9 0>;
                nxp,pn544-irq = <&ap_gpio 127 0>;
                nxp,pn544-clkreq = <&ap_gpio 147 0>;
                nxp,pn544-ven = <&ap_gpio 150 0>;
                nxp,pn544-fw-dwnld = <&ap_gpio 186 0>;
                interrupt-names = "nfc_int";
                clock-names = "bb_clk","source","enable";
                clocks = <&aonapb_gate CLK_AUX1>, <&pmu_gate CLK_26M_AUD>, <&aonapb_gate CLK_AUX1_EB>;
        };
};
