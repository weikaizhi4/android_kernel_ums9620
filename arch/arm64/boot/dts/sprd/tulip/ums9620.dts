/*****************************************
Do not modify dts file, please modify according dtsi file
******************************************/
#include "../ums9620.dts"
#include "sprd_base_diff.dtsi"

