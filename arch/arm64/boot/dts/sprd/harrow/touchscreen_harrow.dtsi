&spi1 {
	status = "okay";
	#address-cells = <1>;
	#size-cells = <0>;
	/delete-node/ touchpanel@0;
	zte-ts@0 {
		compatible = "tchip,ilitek", "focaltech,fts";
		reg = <0>;
		spi-max-frequency = <9600000>;
 		touch,irq-gpio = <&ap_gpio 13 0x2008>; /* IRQF_ONESHOT | IRQF_TRIGGER_LOW */
 		touch,reset-gpio = <&ap_gpio 14 0x0000>;
		focaltech,reset-gpio = <&ap_gpio 14 0x0000>;
		focaltech,irq-gpio =  <&ap_gpio 13 0x2008>; /* IRQF_ONESHOT | IRQF_TRIGGER_LOW */
		focaltech,display-coords = <0 0 1079 2407>;
		focaltech,max-touch-number = <10>;
 	};
};
