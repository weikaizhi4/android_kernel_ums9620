/*
 * this file is ued to change sprd dtsi which can't be changed by overlay
 * such as /delete-node/ /delete-property/ and alises
 */

#include "touchscreen_harrow.dtsi"
#include "zte_charger_harrow.dtsi"
#include "zte_audio_harrow.dtsi"
#include "zte_camera_harrow.dtsi"
#include "zte_sar_harrow.dtsi"
#include "zte_fingerprint_harrow.dtsi"

/{
	zte_tp:zte_tp {
		compatible = "zte_tp";
		zte,tp_algo;
		zte,tp_long_press;
		zte,tp_long_press_timer = <800>;
		zte,tp_long_press_left_v = <15>;
		zte,tp_long_press_right_v = <15>;
		zte,tp_long_press_left_h = <20>; /*camera */
		zte,tp_long_press_right_h = <15>; /*charger */
		zte,tp_edge_click_suppression_pixel = <3>;
	};
};