
&i2c2 {
        status = "okay";
	#address-cells = <1>;
        #size-cells = <0>;
        nfc@8 {
                compatible = "st,st21nfc";
                reg = <0x8>;
                interrupt-parent = <&ap_gpio>;
                interrupts = <9 0>;
                irq-gpios = <&ap_gpio 127 0>;
                reset-gpios = <&ap_gpio 150 0>;
                clkreq-gpios = <&ap_gpio 147 0>;
                interrupt-names = "nfc_int";
                clock-names = "clk_aux1","ext_26m","aux1_eb";
                clocks = <&aonapb_gate CLK_AUX1>, <&pmu_gate CLK_26M_AUD>, <&aonapb_gate CLK_AUX1_EB>;
        };
};
