&spi1 {
	status = "okay";
	#address-cells = <1>;
	#size-cells = <0>;
	/delete-node/ touchpanel@0;
	zte-ts@0 {
		compatible = "sitronix_ts", "chipone-tddi", "gcore,touchscreen";
		reg = <0>;
		spi-max-frequency = <9600000>;
		irq-gpio = <&ap_gpio 13 0>;
		rst-gpio = <&ap_gpio 14 0>;
		chipone,rst-gpio = <&ap_gpio 14 0>;
		chipone,irq-gpio = <&ap_gpio 13 0>;
		chipone,x-res = <719>;
		chipone,y-res = <1599>;
		gcore,irq-gpio =  <&ap_gpio 13 0>;
		gcore,rst-gpio = <&ap_gpio 14 0>;
 	};
};
