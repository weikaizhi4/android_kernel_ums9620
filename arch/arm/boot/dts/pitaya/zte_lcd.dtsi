

/*
#include "zte_lcd_easyquick_gc9503_boe_6p26_480p.dtsi"
#include "zte_lcd_skyworth_st7701_ctc_6p26_480p.dtsi"
#include "zte_lcd_dummy_mipi.dtsi"
*/

&dphy {
	/delete-property/ sprd,ulps-disabled;
};

/*&i2c4 {
	ti65132b@3e {
		compatible = "tps,ti65132b";
		reg = <0x3e>;
	};
};
*/

&panel {
	/*sprd,surface-width = <480>;*/
	/*sprd,surface-height = <960>;*/
	avdd-gpio = <&ap_gpio 62 GPIO_ACTIVE_HIGH>;
	avee-gpio = <&ap_gpio 89 GPIO_ACTIVE_HIGH>;
	reset-gpio = <&ap_gpio 50 GPIO_ACTIVE_HIGH>;
};
