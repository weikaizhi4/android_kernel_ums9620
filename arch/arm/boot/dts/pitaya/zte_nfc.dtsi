&i2c4 {
	status = "okay";
	nfc_pn5xx: pn544@29 {
		compatible = "nxp,pn544";
		reg = <0x29>;
		interrupt-parent = <&ap_gpio>;
		interrupts = <94 0>;
		nxp,pn544-irq = <&ap_gpio 121 0>;
		nxp,pn544-clkreq = <&ap_gpio 94 0>;
		nxp,pn544-ven = <&ap_gpio 95 0>;
		nxp,pn544-fw-dwnld = <&ap_gpio 96 0>;
		interrupt-names = "nfc_int";
		clock-names = "bb_clk","source","enable";
		clocks =<&aon_clk CLK_AUX1>,<&ext_26m>,<&aonapb_gate CLK_AUX1_EB>;
	};
};
