## drivers/vendor/common/touchscreen_v2/omnivision_tcm/Kconfig
```kconfig
#
# Omnivision TCM touchscreen driver configuration
#

config TOUCHSCREEN_OMNIVISION_TCM
	bool "Omnivision TCM touchscreen"
	default n
	help
	  Say Y here if you have a Omnivision TCM touchscreen connected
	  to your system

	  If unsure, say N.

config TOUCHSCREEN_OMNIVISION_TCM_I2C
	bool "I2C"
	default n
	help
	  Say Y here to use I2C method

	  If unsure, say N

config TOUCHSCREEN_OMNIVISION_TCM_SPI
	bool "SPI"
	default n
	help
	  Say Y here to use SPI method

	  If unsure, say N
```

## drivers/vendor/common/touchscreen_v2/sitronix_incell/Kconfig
```kconfig
#
# sitronix Touchscreen driver configuration
#

config TOUCHSCREEN_SITRONIX_INCELL
    bool "sitronix Touchscreen"
    default n
    help
      Say Y here if you have sitronix touch panel.
      If unsure, say N.
```

## drivers/vendor/common/touchscreen_v2/tlsc6x_v3/Kconfig
```kconfig
#
# TLSC6X_V3 Touchscreen driver configuration
#

config TOUCHSCREEN_TLSC6X_V3
	bool "Chipsemicorp Touchscreen"
		depends on I2C
		default n
		help
		  Say Y here if you have tlsc6x touch panel.
		  If unsure, say N.
```

## drivers/vendor/common/vcfg/Kconfig
```kconfig
config VENDOR_CONFIG_COMMON_HELPER
	bool "VENDOR CONFIG HELPER"
	default n
	help
	  Say 'y' here to include support for vendor config helper.
```

## drivers/vendor/common/zte_lcdbl/Kconfig
```kconfig
# LCD backlight power ctrl
config ZTE_LCDBL_I2C_CTRL_VSP_VSN
	tristate "ZTE LCD backlight power ctrl"

        default n
config ZTE_LCDBL_I2C_CTRL_VSP_VSN_ENHANCE
        bool "Support for ZTE vsp vsn power enhance ctrl"
        default n
```

## drivers/vendor/soc/sprd/Kconfig
```kconfig
#
# Kconfig for the sprd kernel device drivers.
#

config ZTE_BOOTREASON
	tristate "Zte Bootreason"
	default n
	help
	  Say Y here, support zte bootreason.
```

## sound/soc/codecs/aw881xx/Kconfig
```kconfig
config ZTE_AW881XX_SMART_PA
	tristate "SoC Audio for awinic aw881xx series"
	depends on I2C
	help
	  This option enables support for aw881xx series Smart PA.
```

## sound/soc/codecs/aw883xx/Kconfig
```kconfig
config ZTE_AW883XX_SMART_PA
    tristate "SoC Audio for awinic aw883xx series"
    depends on I2C
    help
      This option enables support for aw883xx series Smart PA.
```
