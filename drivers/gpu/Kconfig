## drivers/gpu/Kconfig
```kconfig
# SPDX-License-Identifier: GPL-2.0-only

source "drivers/gpu/arm/midgard/mali/Kconfig"
```

## drivers/vendor/common/Kconfig
```kconfig
config VENDOR_COMMON_COMPILE
	bool "drivers/vendor/common drivers compile control"
	default n
	help
	  This enables drivers/vendor/common drivers to be compiled.

config VENDOR_SOC_QCOM_COMPILE
	bool "drivers/vendor/soc/qcom drivers compile control"
	default n
	help
	  This enables drivers/vendor/soc/qcom drivers to be compiled.

config VENDOR_SOC_MTK_COMPILE
	bool "drivers/vendor/soc/mediatek drivers compile control"
	default n
	help
	  This enables drivers/vendor/soc/mediatek drivers to be compiled.

config VENDOR_SOC_SPRD_COMPILE
	bool "drivers/vendor/soc/sprd drivers compile control"
	default n
	help
	  This enables drivers/vendor/soc/sprd drivers to be compiled.

config SOC_QCOM
	bool "qcom common drivers"
	default n
	help
	  This enables support for common driver in qcom platform.

config SOC_MTK
	bool "MTK common drivers"
	default n
	help
	  This enables support for common driver in MTK platform.

config SOC_SPRD
	bool "spred common drivers"
	default n
	help
	  This enables support for common driver in sprd platform.

config VENDOR_SQC_CHARGER
	bool "sqc charger platform common drivers"
	default n
	help
	  This enables support for platform sqc common driver.

source "drivers/vendor/common/touchscreen_v2/Kconfig"
source "drivers/vendor/common/nxp_tfa9894/Kconfig"
source "drivers/vendor/common/power/Kconfig"
source "drivers/vendor/common/sqc/Kconfig"
source "drivers/vendor/common/sqc_v2/Kconfig"
source "drivers/vendor/common/sqc_base/Kconfig"
source "drivers/vendor/common/sqc_v7/Kconfig"
source "drivers/vendor/common/vcfg/Kconfig"
source "drivers/vendor/common/awinic/Kconfig"
source "drivers/vendor/common/tfa9873/Kconfig"
source "drivers/vendor/common/sensor/Kconfig"
source "drivers/vendor/common/leds/Kconfig"
source "drivers/vendor/common/zlog/Kconfig"
source "drivers/vendor/common/sqc_v8/Kconfig"
source "drivers/vendor/common/zcard_det/Kconfig"

##### Fingerprint #####
source "drivers/vendor/common/fingerprint/Kconfig"
#lcd
source "drivers/vendor/common/zte_lcdbl/Kconfig"
```

## drivers/vendor/common/fingerprint/Kconfig
```kconfig
#
# Fingerprint driver configuration
#

config ZTE_PLATFORM_FINGERPRINT
       tristate "ZTE Fingerprint"
       default n
       ---help---
       ZTE Fingerprint Driver

######### Goodix #########
source "drivers/vendor/common/fingerprint/goodix/Kconfig"

######### Silead #########
source "drivers/vendor/common/fingerprint/silead/Kconfig"

######### Cdfinger #########
source "drivers/vendor/common/fingerprint/cdfinger/Kconfig"

######### Chipone #########
source "drivers/vendor/common/fingerprint/chipone/Kconfig"

######### Sunwave #########
source "drivers/vendor/common/fingerprint/sunwave/Kconfig"

######### Egis #########
source "drivers/vendor/common/fingerprint/egis/Kconfig"

######### Fpc #########
source "drivers/vendor/common/fingerprint/fpc/Kconfig"

######### Fpc1020 #########
source "drivers/vendor/common/fingerprint/fpc1020/Kconfig"

######### focaltech #########
source "drivers/vendor/common/fingerprint/focaltech/Kconfig"
```

## drivers/vendor/common/fingerprint/chipone/Kconfig
```kconfig
#
# chipone Fingerprint driver configuration
#

config PLATFORM_FINGERPRINT_CHIPONE
       bool "generic chipone fingerprint driver"
       default n
       help
       add support for chipone fingerprint driver.

config CHIPONE_NAV_NEW
       bool "chipone Fingerprint nav new"
       default n
       help
       CHIPONE Fingerprint nav new
```

## drivers/vendor/common/fingerprint/focaltech/Kconfig
```kconfig
#
# focaltech Fingerprint driver configuration
#

config PLATFORM_FINGERPRINT_FOCALTECH
       bool "generic focaltech fingerprint driver"
       default n
       help
       add support for focaltech fingerprint driver.
```

## drivers/vendor/common/fingerprint/sunwave/Kconfig
```kconfig
#
# sunwave Fingerprint driver configuration
#

config PLATFORM_FINGERPRINT_SUNWAVE
       bool "generic sunwave fingerprint driver"
       default n
       help
       add support for sunwave fingerprint driver.

config PLATFORM_FINGERPRINT_SUNWAVE_PWR_MODE_REGULATOR
       bool "Sunwave Fingerprint power regulator"
       default n
       help
       SUNWAVECORP Fingerprint power regulator, default GPIO

config SUNWAVE_NAV_NEW
       bool "sunwave Fingerprint nav new"
       default n
       help
       SUNWAVE Fingerprint nav new
```

## drivers/vendor/common/sensor/Kconfig
```kconfig
config ZTE_TEMPERATURE_SENSOR
	bool "ZTE_TEMPERATURE SENSOR"
		depends on I2C
		default n
		help
		  Say Y here if you have zte temperature sensor.
		  If unsure, say N.

config CUSTOM_KERNEL_SAR_SENSOR
	bool "ZTE_SAR SENSOR"
		depends on I2C
		default n
		help
		  Say Y here if you have zte sar sensor.
		  If unsure, say N.

source "drivers/vendor/common/sensor/temperature/Kconfig"
source "drivers/vendor/common/sensor/sar/Kconfig"
```

## drivers/vendor/common/sensor/sar/Kconfig
```kconfig
config SAR_SENSOR_AW9610X
	tristate "SAR_SENSOR_AW9610X"
		depends on I2C
		default n
		help
			Say Y here to build support for sensor hub new.
			To compile this driver as a module, choose M here.

config SAR_SENSOR_AW9610X_2
	tristate "SAR_SENSOR_AW9610X_2"
		depends on I2C
		default n
		help
			Say Y here to build support for sensor hub new.
			To compile this driver as a module, choose M here.

source "drivers/vendor/common/sensor/sar/aw9610x/Kconfig"
```

## drivers/vendor/common/touchscreen_v2/Kconfig
```kconfig
#
# Touchscreen driver configuration
#
config TOUCHSCREEN_VENDOR_V2
	tristate "Touchscreens"
	default n
	help
	  Say Y here, and a list of supported touchscreens will be displayed.
	  This option doesn't affect the kernel.

	  If unsure, say n.

source "drivers/vendor/common/touchscreen_v2/goodix_berlin_driver_v2/Kconfig"
source "drivers/vendor/common/touchscreen_v2/chipone_tddi_v2/Kconfig"
source "drivers/vendor/common/touchscreen_v2/chipone_tddi_v3/Kconfig"
source "drivers/vendor/common/touchscreen_v2/chsc5xxx/Kconfig"
source "drivers/vendor/common/touchscreen_v2/ilitek_tddi_v3/Kconfig"
source "drivers/vendor/common/touchscreen_v2/focaltech_touch_V3_3/Kconfig"
source "drivers/vendor/common/touchscreen_v2/focaltech_touch_ufp/Kconfig"
source "drivers/vendor/common/touchscreen_v2/tlsc6x_v3/Kconfig"
source "drivers/vendor/common/touchscreen_v2/gcore_ts/Kconfig"
source "drivers/vendor/common/touchscreen_v2/gcore_ts_v3/Kconfig"
source "drivers/vendor/common/touchscreen_v2/betterlife_ts/Kconfig"
source "drivers/vendor/common/touchscreen_v2/sitronix_incell/Kconfig"
source "drivers/vendor/common/touchscreen_v2/omnivision_tcm/Kconfig"

config TOUCHSCREEN_BOARD_NAME
	string "config board firmware folder"

config TOUCHSCREEN_DRM_PANEL_NOTIFIER
	bool "add qcom drm panel support"
	default n
	help
	  Say Y here to enable debug tools.

	  If unsure, say N.

config TOUCHSCREEN_UFP_MAC
	bool "tp under fingerprint status machine"
	default n
	help
	  Say Y here if you want to have a under fingerprint status machine
	  If unsure, say N.

config TOUCHSCREEN_POINT_REPORT_CHECK
	bool "all point clean when tp irq timeout"
	default n
	help
	  Say Y here to enable .
	  If unsure, say N.
config TOUCHSCREEN_POINT_SIMULAT_UF
 	bool "tp under fingerprint status machine"
 	default n
 	help
 	  Say Y here if you want to simulate finger down
 	  If unsure, say N.
config TOUCHSCREEN_LCD_NOTIFY
 	bool "lcd state notify"
 	default n
	depends on ZTE_LCD_COMMON_FUNCTION
 	help
 	  Say Y here if you use lcd notify tp suspend/resume.If unsure, say N.
```
