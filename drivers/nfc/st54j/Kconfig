## drivers/nfc/st54j/Kconfig
```kconfig
config NFC_ST21NFCJ
	bool "NFC_ST21NFCJ Controller"
	---help---
	  You'll have to say Y if your computer contains an NFC_ST21NFCJ I2C device that
	  you want to use under Linux.

	  You can say N here if you don't have any NFC_ST21NFCJ I2C connected to your computer.

config NFC_ST54J
	bool "NFC_ST54J Controller"
	---help---
	  You'll have to say Y if your computer contains an NFC_ST54J I2C device that
	  you want to use under Linux.

	  You can say N here if you don't have any NFC_ST54J I2C connected to your computer.
```

## drivers/vendor/common/awinic/Kconfig
```kconfig
config SND_SMARTPA_AW881XX
	tristate "SoC Audio for awinic aw881xxseries"
	depends on I2C
	help
        	This option enables support for aw881xxseries Smart PA.

config SND_SEC_I2S_AW881XX
	tristate "SoC Audio for awinic aw881xxseries"
	depends on I2C
	help
        	This option enables support SEC I2S for aw881xxseries Smart PA.
```

## drivers/vendor/common/fingerprint/cdfinger/Kconfig
```kconfig
#
# CDFINGER Fingerprint driver configuration
#

config PLATFORM_FINGERPRINT_CDFINGER
       bool "FPS Fingerprint"
       default n
       ---help---
       cdfinger Fingerprint chip FPS980S TEE driver
```

## drivers/vendor/common/fingerprint/egis/Kconfig
```kconfig
#
# Egis Fingerprint driver configuration
#

config PLATFORM_FINGERPRINT_EGIS
	bool "Egis Fingerprint"
	default n
	---help---
	Egis Fingerprint chip ET552 TEE driver
```

## drivers/vendor/common/fingerprint/fpc/Kconfig
```kconfig
#
# FPC sensors
#

config PLATFORM_FINGERPRINT_FPC
	bool "fpc fingerprint driver"
	default n
	help
		If you say yes here you get IRQ support for fingerprint
		sensors from Fingerprint Cards (FPC).
```

## drivers/vendor/common/fingerprint/fpc1020/Kconfig
```kconfig
config PLATFORM_FINGERPRINT_FPC1020
	bool "FPC1020 Fingerprint"
	default n
	help
	  Support FPC1020 capacitive fingerprint sensor device.
```

## drivers/vendor/common/fingerprint/goodix/Kconfig
```kconfig
#
# Goodix Fingerprint driver configuration
#

config PLATFORM_FINGERPRINT_GOODIX
       bool "generic goodix fingerprint driver"
       default n
       help
       add support for goodix fingerprint driver.

config GOODIX_NAV_REVERT
       bool "goodix Fingerprint nav revert"
       default n
       help
       GOODIX Fingerprint nav revert

config GOODIX_NAV_REVERT_NEW
       bool "goodix Fingerprint nav revert new"
       default n
       help
       GOODIX Fingerprint nav revert new
```

## drivers/vendor/common/fingerprint/silead/Kconfig
```kconfig
#
# Silead Fingerprint driver configuration
#

config PLATFORM_FINGERPRINT_SILEAD
       bool "Silead Fingerprint driver support"
       default n
       help
       This supports Silead Fingerprint drivers.
```

## drivers/vendor/common/leds/Kconfig
```kconfig
config ZTE_BREATHING_LIGHT_LEDS
	bool "ZTE_BREATHING_LIGHT_LEDS"
		depends on I2C
		default n
		help
		  Say Y here if you have zte breathing light leds chip.
		  If unsure, say N.

source "drivers/vendor/common/leds/aw210xx/Kconfig"
source "drivers/vendor/common/leds/aw2016/Kconfig"
```

## drivers/vendor/common/leds/aw2016/Kconfig
```kconfig
config ZTE_LEDS_AW2016
	tristate "ZTE_LEDS_AW2016"
		depends on I2C
		default n
		help
		  Say Y here if you have crypto breathing light leds chip aw2016.
		  If unsure, say N.
```

## drivers/vendor/common/leds/aw210xx/Kconfig
```kconfig
config ZTE_LEDS_AW210XX
	tristate "ZTE_LEDS_AW210XX"
		depends on I2C
		default n
		help
		  Say Y here if you have crypto breathing light leds chip aw210xx.
		  If unsure, say N.
```

## drivers/vendor/common/nxp_tfa9894/Kconfig
```kconfig
config NXP_TFA9894_SMARTPA
	bool "NXP TFA9894 SmartPA"

config NXP_TFA9894_SMARTPA_STEREO
	bool "NXP TFA9894 SmartPA STEREO"
```

## drivers/vendor/common/power/Kconfig
```kconfig
menuconfig POWER_VENDOR_COMMON
	tristate "zte vendor common"
	default n
	help
	  Say Y here, if supported zte power policy

config VENDOR_ZTE_MISC
	tristate "zte misc module"
	default n
	help
	  Say Y here to enable the "pmic voter module" driver

config VENDOR_POWER_VOTER
	tristate "pmic voter module"
	default n
	help
	  Say Y here to enable the "pmic voter module" driver

config CHGING_WITH_VOTER
	tristate "charging setting use voter module"
	default n
	help
	  Say Y here to enable the "charging setting use voter module" driver

config VENDOR_BATTERY_CAPACITY_LEARNING
	tristate "Battery Capacity Learning driver"
	default n
	help
	  Say Y here to enable the "Battery Capacity Learning" driver

config VENDOR_CHARGE_ARBITRATE_SERVICE
	tristate "Charge Arbitrate Service Driver"
	default n
	help
	  Say Y here to enable the "Charge Arbitrate Service" driver

config VENDOR_CHARGE_ARBITRATE_SERVICE_COMMON
	tristate "Charge Arbitrate Service Driver COMMON"
	default n
	help
	  Say Y here to enable the "Charge Arbitrate Service Common" driver

config VENDOR_CHARGER_POLICY_SERVICE
	tristate "Charger Policy Service Driver"
	default n
	help
	  Say Y here to enable the "Charger Policy Service" driver

config VENDOR_CPU_RATE_CTRL
	tristate "use cpu rate ctrl charging current"
	default n
	help
	  Say Y here to enable the "Charger Policy Service" driver

config VENDOR_MTK_FG_RES_2MO
	tristate "Control the sampling resistor of the mtk fuel gauge using 2 milliohms"
	default n
	help
	  Say Y here to enable the "mtk fuel gauge using 2 milliohms" driver
```

## drivers/vendor/common/sensor/sar/aw9610x/Kconfig
```kconfig
config SAR_PARA
	string "config sar param"
	default "default"
	help
		Sar sensor param macro
```

## drivers/vendor/common/sensor/temperature/Kconfig
```kconfig
config SENSOR_MLX90632
	bool "SENSOR MLX90632"
		depends on I2C
		default n
		help
		  Say Y here if you have tlsc6x touch panel.
		  If unsure, say N.
```

## drivers/vendor/common/sqc/Kconfig
```kconfig
menuconfig VENDOR_SQC_CHARGER_V0
	bool "zte power policy"
	default n
	help
	  Say Y here, if supported zte sqc charger
```

## drivers/vendor/common/sqc_v2/Kconfig
```kconfig
menuconfig VENDOR_SQC_CHARGER_V2
	bool "sqc power policy"
	default n
	help
	  Say Y here, if supported zte sqc charger v2
```

## drivers/vendor/common/sqc_v7/Kconfig
```kconfig
config VENDOR_SQC_CHARGER_VERSION
	string "define zte sqc charger version"
	help
	This config is to select which zte sqc_version charger driver you want to use.


config VENDOR_SQC_CHARGER_V7
	bool "zte power policy"
	default n
	help
	  Say Y here, if supported zte sqc charger

config VENDOR_SQC_QCOM_QC3PLUS
	bool "Use Qcom QC3+ protocol chip"
	default n
	help
	  Say Y here, if supported zte sqc qcom QC3+ protocol chip.

config VENDOR_SQC_ZTE_FG
	bool "Use Qcom QC3+ protocol chip"
	default n
	help
	  Say Y here, if supported zte sqc qcom QC3+ protocol chip.
```

## drivers/vendor/common/sqc_v8/Kconfig
```kconfig
# SPDX-License-Identifier: GPL-2.0-only
config VENDOR_SQC_MODULE
	tristate "sqc power policy"
	help
	  Say Y here, if supported zte sqc charger

config VENDOR_SQC_CHARGER_V8
	bool "sqc power v8"
	default n
	help
	  Say Y here, if supported zte sqc charger v8

config VENDOR_SQC_NETLINK
	tristate "sqc power NETLINK"
	help
	  Say Y here, if supported zte sqc charger NETLINK

config VENDOR_SQC_BQ2560X
	tristate "sqc power bq2560x"
	help
	  Say Y here, if supported zte sqc charger BQ2560X

config VENDOR_SQC_BQ2597X
	tristate "sqc power bq2597x"
	help
	  Say Y here, if supported zte sqc charger bq2597x
```

## drivers/vendor/common/touchscreen_v2/betterlife_ts/Kconfig
```kconfig
#
# betterlife Touchscreen driver configuration
#

config TOUCHSCREEN_BETTERLIFE_TS
    bool "betterlife tp"
	default n
	---help---
	betterlife tp.

config TOUCHSCREEN_BETTERLIFE_TS_FACTORY_TEST
    bool "betterlife tp self test"
    default n
    depends on TOUCHSCREEN_BETTERLIFE_TS
```

## drivers/vendor/common/touchscreen_v2/chipone_tddi_v2/Kconfig
```kconfig
#
# Chipone Touchscreen driver configuration
#

config TOUCHSCREEN_CHIPONE_V2
	bool "chipone incell tp SPI method of 9916 and 9922"
	default n
	help
		Say Y here if you have chipone touchscreen.
		chipone controllers are multi touch controllers which can
		report 10 touches at a time.
		If unsure, say N.
```

## drivers/vendor/common/touchscreen_v2/chipone_tddi_v3/Kconfig
```kconfig
#
# Chipone Touchscreen driver configuration
#

config TOUCHSCREEN_CHIPONE_V3
	bool "chipone incell tp SPI method of 9911"
	default n
	help
		Say Y here if you have chipone touchscreen.
		chipone controllers are multi touch controllers which can
		report 10 touches at a time.
		If unsure, say N.
```

## drivers/vendor/common/touchscreen_v2/gcore_ts/Kconfig
```kconfig
#
# TLSC6X_V3 Touchscreen driver configuration
#

config TOUCHSCREEN_GCORE_TS
	bool "gcore Touchscreen"
		depends on I2C
		default n
		help
		  Say Y here if you have tlsc6x touch panel.
		  If unsure, say N.
```

## drivers/vendor/common/touchscreen_v2/gcore_ts_v3/Kconfig
```kconfig
#
# GCORE_V3 Touchscreen driver configuration
#

config TOUCHSCREEN_GCORE_TS_V3
	bool "gcore Touchscreen"
		default n
		help
		  Say Y here if you have gcore touch panel.
		  If unsure, say N.
```

## drivers/vendor/common/touchscreen_v2/ilitek_tddi_v3/Kconfig
```kconfig
#
# Iltek Touchscreen driver configuration
#

config TOUCHSCREEN_ILITEK_TDDI_V3
	bool "ilitek tddi 9881xk Touchscreen"
	default n
	help
	Say Y here if you have ilitek touch panel.

if TOUCHSCREEN_ILITEK_TDDI_V3
config TOUCHSCREEN_ILITEK_TDDI_V3_I2C
	bool "Ilitek I2C Touchscreen"
	depends on I2C
	default n
	help
	Say Y here if you have ilitek i2c touch panel.

config TOUCHSCREEN_ILITEK_TDDI_V3_SPI
	bool "Ilitek spi Touchscreen"
	depends on SPI
	default n
	help
	Say Y here if you have ilitek spi touch panel.
endif
```
